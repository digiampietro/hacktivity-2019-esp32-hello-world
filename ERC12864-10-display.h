#ifndef ERC12864_10_display

#include <Wire.h>

#define DISP_CMD_ADDR 0x38
#define DISP_DAT_ADDR 0x39

const uint8_t pic0[]=
{/*ERC12864-10 Series.bmp  --*/
/*-- 128x64  --*/
0xFF,0x01,0x01,0xF9,0x49,0x49,0x49,0x49,0x01,0xC1,0xB1,0x89,0xB1,0xC1,0x01,0x31,
0x49,0x49,0x91,0x01,0x09,0x09,0xF9,0x09,0x09,0x01,0xF9,0x49,0x49,0xC9,0x31,0x01,
0x01,0xF9,0x01,0x01,0x31,0x49,0x49,0x91,0x01,0x01,0xF9,0x01,0x01,0xF9,0x31,0x41,
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0x9F,0x8F,0x80,0x9F,0x9F,0x80,0x80,0x9F,0x9F,0x80,0x80,0x9F,0x9F,0x80,0x80,0xFF,

};

const uint8_t pic[]= { /* 0X22,0X01,0X80,0X00,0X40,0X00, */
0X00,0X00,0X00,0X00,0X00,0X30,0X00,0X60,0X00,0X40,0X80,0X00,0X00,0X00,0X00,0X00,
0X00,0X00,0X00,0X00,0X00,0X00,0X00,0X00,0X00,0X00,0X00,0X00,0X00,0X00,0X00,0X00,
0X00,0X00,0X00,0X00,0X00,0X00,0X00,0X00,0X00,0X00,0X00,0X00,0X00,0X00,0X00,0X00,
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0X00,0X00,0X00,0X00,0X00,0X00,0X00,0X00,0X00,0X00,0X00,0X00,0X00,0X00,0X00,0X00,
};


void dispSendCmd(uint8_t buf[], uint8_t len) {
  byte error;
  byte i;
  Wire.beginTransmission(DISP_CMD_ADDR);
  for (i=0; i < len; i++) {
    Wire.write(buf[i]);
  }
  error = Wire.endTransmission();
  if (error == 0) {
    Serial.print("Sent n bytes: ");
    Serial.println(len);
  } else {
    Serial.print("Error sending n bytes: ");
    Serial.println(len);
  }
}

void dispSendCmd(uint8_t c) {
  byte error;
  Wire.beginTransmission(DISP_CMD_ADDR);
  Wire.write(c);
  error = Wire.endTransmission();
  if (error == 0) {
    Serial.print("Successfully send command: ");
    Serial.println(c);
  } else {
    Serial.print("Error sending command: ");
    Serial.println(c);
  }  
  delay(10);
}

void dispSendData(uint8_t c) {
  byte error;
  Wire.beginTransmission(DISP_DAT_ADDR);
  Wire.write(c);
  error = Wire.endTransmission();
  if (error == 0) {
    Serial.print("Successfully send data: ");
    Serial.println(c);
  } else {
    Serial.print("Error sending data: ");
    Serial.println(c);
  }  
}

void dispSetAllPixelOn(uint8_t onOff) {
  byte c = 0xa4 | (onOff & 1);
  byte error;
  byte z = 0x00;
  Wire.beginTransmission(DISP_CMD_ADDR);
  Wire.write(c);
  error = Wire.endTransmission();
  if (error == 0) {
    Serial.print("Successfully set all pixel on ");
    Serial.println(c);
  } else {
    Serial.print("Error setting all pixel on ");
    Serial.println(c);
  }  
}



void dispSetPageAddr(uint8_t addr) {
  addr=0xb0 | addr;
  dispSendCmd(addr);
}

void dispSetColumnAddr(uint8_t addr) {
  uint8_t buf[2];
  buf[0] = 0x10 | (addr >> 4);
  buf[1] = (0x0f & addr) | 0x04;
  dispSendCmd(buf,2);
}

void dispPicture(const uint8_t pic[]) {
  uint8_t i, j, num=0, error;
  for (i=0; i<8; i++) {
    dispSetPageAddr(i);
    dispSetColumnAddr(0);
    Wire.beginTransmission(DISP_DAT_ADDR);
    for (j=0; j<0x80; j++) {
//    for (j=0; j<1; j++) {
      Wire.write(pic[i*0x80+j]);
    }
    error = Wire.endTransmission();
    if (error == 0) {
      Serial.println("Sent Data bytes ");
    } else {
      Serial.println("Error sending data bytes ");
    }  
  }
}

void dispFixedByte(uint8_t b) {
  uint8_t i, j, num=0, error;
  for (i=0; i<8; i++) {
    dispSetPageAddr(i);
    dispSetColumnAddr(0);
    Wire.beginTransmission(DISP_DAT_ADDR);
    for (j=0; j<0x80; j++) {
//    for (j=0; j<1; j++) {
      Wire.write(b);
    }
    error = Wire.endTransmission();
    if (error == 0) {
      Serial.println("Sent Data bytes ");
    } else {
      Serial.println("Error sending data bytes ");
    }  
  }
}


void dispSetPowerControl(void) {
  byte c = 0x2f;
  byte error;
  byte z = 0x00;
  Wire.beginTransmission(DISP_CMD_ADDR);
  Wire.write(c);
  error = Wire.endTransmission();
  if (error == 0) {
    Serial.print("Successfully set Power Control ");
    Serial.println(c);
  } else {
    Serial.print("Error setting Power Control ");
    Serial.println(c);
  }  
}

void dispInit(void) {
  dispSendCmd(0x2f);            //Power_Control
  dispSendCmd(0xA2);            // BIAS Setting   A2(1/9);A3(1/7)
  dispSendCmd(0xA0);            // Set SEG Direction. It was initially 0xA1 
  dispSendCmd(0xC8);            // Set COM Direction. It was initially 0xC8
                          
  dispSendCmd(0x24);            // Set VLCD Resistor Ratio    0-7
  dispSendCmd(0x81);            // Set Electronic Volume
  dispSendCmd(37);              // Contrast level  0~63
  dispSendCmd(0x40);            // Initial_Dispay_Line
  dispSendCmd(0xAF);            // Display ON

  // dispSetAllPixelOn(0);
  dispPicture(pic);
  // dispFixedByte(0x03);
  // delay(2000);
  // dispSetAllPixelOn(1);
}



#endif
